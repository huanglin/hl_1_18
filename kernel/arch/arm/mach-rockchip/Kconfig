## kernel/arch/arm/mach-rockchip/Kconfig
```kconfig
if ARCH_ROCKCHIP

menu "Rockchip system-on-chip"


choice 
	prompt "machine products"
config RK2818_SDK
	bool "Rockchip  rk2818 sdk board"
	depends on ARCH_ROCKCHIP
	select CHIP_RK2818

config RK2818_A7
	bool "Rockchip  rk2818 A7 product"
	depends on ARCH_ROCKCHIP
	select CHIP_RK2818

config RK2818_A7_V1_1
        bool "Rockchip  rk2818 A7 V1.1 product"
        depends on ARCH_ROCKCHIP
        select CHIP_RK2818

config RK2808_SDK
	bool "Rockchip  rk2808 sdk board for development"
	depends on ARCH_ROCKCHIP
	select CHIP_RK2808

endchoice

choice 
	prompt "Eink products"
config RK2818_BOARD_SDK
	bool "Rockchip rk2818 board sdk"
	depends on ARCH_ROCKCHIP
	select CHIP_RK2818

config RK2818_BOARD_REF
	bool "Rockchip rk2818 board ref"
	depends on ARCH_ROCKCHIP
	select CHIP_RK2818

endchoice

choice 
	prompt "Select DDR TYPE"
config DDR2
	bool "DDR2 TYPE"
	depends on ARCH_ROCKCHIP
	select CHIP_RK2818
config LPDDR
	bool "LPDDR TYPE"
	depends on ARCH_ROCKCHIP
	select CHIP_RK2818
endchoice

comment  "rockchip chip type"
config CHIP_RK2818
	bool		
config CHIP_RK2808
	bool	
	
if ARCH_ROCKCHIP

comment  "rockchip processor"
	
config CPU_ARM926T
	bool "CPU_ARM926T"
	default y

config CPU_32
	bool "CPU_32"
	default y
		
config CPU_32v5
	bool "CPU_32v5"
	default y
		
config CPU_ABRT_EV5TJ
	bool "CPU_ABRT_EV5TJ"
	default y
		
config CPU_CACHE_VIVT
	bool "CPU_CACHE_VIVT"
	default y
		
config CPU_COPY_V4WB
	bool "CPU_COPY_V4WB"
	default y
		
config CPU_TLB_V4WBI
	bool "CPU_TLB_V4WBI"
	default y
		
config CPU_CP15
	bool "CPU_CP15"
	default y
		
config CPU_CP15_MMU
	bool "CPU_CP15_MMU"
	default y

config CPU_CP15
	bool "PROCESS_CP15"
	default y

endif

endmenu

endif
```

## kernel/drivers/input/touchscreen/Kconfig
```kconfig
#
# Touchscreen driver configuration
#
menuconfig INPUT_TOUCHSCREEN
	bool "Touchscreens"
	help
	  Say Y here, and a list of supported touchscreens will be displayed.
	  This option doesn't affect the kernel.

	  If unsure, say Y.

if INPUT_TOUCHSCREEN


config RK28_I2C4310_TS
	tristate "RK28 i2c touchscreen (ra4310)"
	depends on I2C_RK28
	help
	    say Y here if you have a touchscreen interface using the i2c controller, 
	    and your-specific setup code includes that in its table of i2c devices.	 	

config  RK28_I2C_TS_GTT8205S
	tristate "RK28 i2c touchscreen (gtt8205s)"
	depends on I2C_RK28
	help 
	    say Y here if you have a touchscreen interface using the i2c
            controller, and your-specific setup code includes that in its table of i2c devices.

config  RK28_I2C_TS_SIS809
	tristate "RK28 i2c touchscreen (sis809)"
	depends on I2C_RK28
	help 
	    say Y here if you have a touchscreen interface using the i2c
            controller, and your-specific setup code includes that in its table of i2c devices.	
config TOUCHSCREEN_ELAN
	tristate "Elan based touchscreeens"
	depends on I2C_RK28
		
config  RK28_GPIO_TS
	tristate "RK28 GPIO touchscreen (XPT2046)"
	depends on !SPIM_RK28
	help
	   say Y here if you have a touchscreen interface using the gpio
	   controller, and your-specific setup code includes that in its table of gpio devices.

config RK28_SPI_TS
        tristate "RK28 SDK extern SPI touchscreen (XPT2046)"
        depends on SPI && SPIM_RK28 && (!RK28_GPIO_TS)
        help
           say Y here if you have a touchscreen interface using the spi
           controller, and your-specific setup code includes that in its table of spi devices.

config TS_SPI_XPT2046        
		tristate "XPT2046 SPI touchscreen (Recommended)"
		depends on SPI && SPIM_RK28
		help
			Say Y here if you are using an XPT2046 to drive touchscreen.
			Please make sure SPI bus is enabled!
config TS_SPI_XPT2046_A7
		tristate "XPT2046 A7 SPI touchscreen"
		depends on SPI && SPIM_RK28
		help
			Say Y here if you are using an XPT2046 to drive touchscreen.And this driver apply to 
			ACHOS A7 product.
                        Please make sure SPI bus is enabled!

config TOUCHSCREEN_BITSY
	tristate "Compaq iPAQ H3600 (Bitsy) touchscreen"
	depends on SA1100_BITSY
	select SERIO
	help
	  Say Y here if you have the h3600 (Bitsy) touchscreen.

	  If unsure, say N.

	  To compile this driver as a module, choose M here: the
	  module will be called h3600_ts_input.


config TOUCHSCREEN_USB_EGALAX
	default y
	bool "eGalax, eTurboTouch CT-410/510/700 device support" if EMBEDDED
	depends on TOUCHSCREEN_USB_COMPOSITE

config TOUCHSCREEN_USB_PANJIT
	default y
	bool "PanJit device support" if EMBEDDED
	depends on TOUCHSCREEN_USB_COMPOSITE

config TOUCHSCREEN_USB_3M
	default y
	bool "3M/Microtouch EX II series device support" if EMBEDDED
	depends on TOUCHSCREEN_USB_COMPOSITE

config TOUCHSCREEN_USB_ITM
	default y
	bool "ITM device support" if EMBEDDED
	depends on TOUCHSCREEN_USB_COMPOSITE

config TOUCHSCREEN_USB_ETURBO
	default y
	bool "eTurboTouch (non-eGalax compatible) device support" if EMBEDDED
	depends on TOUCHSCREEN_USB_COMPOSITE

config TOUCHSCREEN_USB_GUNZE
	default y
	bool "Gunze AHL61 device support" if EMBEDDED
	depends on TOUCHSCREEN_USB_COMPOSITE

config TOUCHSCREEN_USB_DMC_TSC10
	default y
	bool "DMC TSC-10/25 device support" if EMBEDDED
	depends on TOUCHSCREEN_USB_COMPOSITE

config TOUCHSCREEN_USB_IRTOUCH
	default y
	bool "IRTOUCHSYSTEMS/UNITOP device support" if EMBEDDED
	depends on TOUCHSCREEN_USB_COMPOSITE

config TOUCHSCREEN_USB_IDEALTEK
	default y
	bool "IdealTEK URTC1000 device support" if EMBEDDED
	depends on TOUCHSCREEN_USB_COMPOSITE

config TOUCHSCREEN_USB_GENERAL_TOUCH
	default y
	bool "GeneralTouch Touchscreen device support" if EMBEDDED
	depends on TOUCHSCREEN_USB_COMPOSITE

config TOUCHSCREEN_USB_GOTOP
	default y
	bool "GoTop Super_Q2/GogoPen/PenPower tablet device support" if EMBEDDED
	depends on TOUCHSCREEN_USB_COMPOSITE

config TP_SWAP_XY
	bool "SWAP XP samples."
  	default y
	help
		Say Y here if you want to swap XY samples.

choice 
  prompt "Touch panel resolution"
  default TP_800x480

  config TP_800x480
  bool "800x480"

  config TP_800x600
  bool "800x600"
  config TP_1024x600
  bool "1024x600"

endchoice

endif
```

## kernel/drivers/misc/rk281x_modem/Kconfig
```kconfig
#
# USB Serial device configuration
#

menuconfig RK281X_SUPPORT_MODEM
	tristate "RK281X support Modem"
	depends on RK2818_HOST11
	---help---
	  Say Y here if you have a support modem

choice
    depends on RK281X_SUPPORT_MODEM
	prompt  "Select 3G Modem"

  config MODEM_ROCKCHIP_DEMO
  	bool "ROCKCHIP_GENERAL_MODEM_DEVICE"
	
#config MODEM_ZTE_MF210
#	bool "ZTE_MF210"
	
#config MODEM_ZTE_AD3812
#	bool "ZTE_AD3812"

#config MODEM_THINKWILL_ME800
#	bool "THINKWILL_ME800"

#config MODEM_HUAWEI_EM660
#	bool "HUAWEI_EM660"
	
#config MODEM_HUAWEI_EM770
#	bool "HUAWEI_EM770"

#config MODEM_HUAWEI_EM660C
 #        bool "HUAWEI_EM660C"

#config MODEM_ZTE_MU301	
#	bool "ZTE_MU301"

#config MODEM_TDM_330
#	bool "TDM_330"

endchoice
```

## kernel/drivers/net/wireless/Kconfig
```kconfig
#
# Wireless LAN device configuration
#

menu "Wireless LAN"
	depends on !S390

config WLAN_80211
	bool "Wireless LAN (IEEE 802.11)"
	depends on NETDEVICES
	---help---
	  Say Y if you have any 802.11 wireless LAN hardware.

	  This option does not affect the kernel build, it only
	  lets you choose drivers.

choice
	prompt "WiFi device driver support"
	default WIFI_NONE

	config WIFI_NONE
	  bool "No WiFi"

	config MV8686
	  depends on WLAN_80211 && MMC
	  select WIRELESS_EXT
	  select IEEE80211
	  select FW_LOADER
	  bool "Marvell 8686 SDIO"
	  ---help---
	    A library for Marvell 8686 SDIO WLAN devices.

	config MV8686_FAC
	  depends on WLAN_80211 && MMC
	  select WIRELESS_EXT
	  select IEEE80211
	  select FW_LOADER
	  bool "Marvell 8686 SDIO (Factory Test Only)"
	  ---help---
	    A library for Marvell 8686 SDIO WLAN devices. This
		driver is for factory test only, such FCC/CE/3C.

	config ATHEROS_AR6002
	  depends on WLAN_80211 && MMC
	  select WIRELESS_EXT
	  select IEEE80211
	  select FW_LOADER
	  bool "Atheros AR6002 SDIO"
	  ---help---
	    A library for Atheros AR6002 SDIO WLAN devices.

	config NANO_NRX700 
	  depends on WLAN_80211 && MMC
	  select WIRELESS_EXT
	  select IEEE80211
	  select FW_LOADER
	  bool "Nanoradio NRX700 SDIO"
	  ---help---
	    A library for Nanoradio NRX700 SDIO WLAN devices.

	config BCM4319 
	  depends on WLAN_80211 && MMC
	  select WIRELESS_EXT
	  select IEEE80211
	  select FW_LOADER
	  bool "Broadcom BCM4319 SDIO"
	  ---help---
	    A library for Broadcom BCM4319 SDIO WLAN devices.

	config BCM4319_FAC 
      depends on WLAN_80211 && MMC 
      select WIRELESS_EXT 
      select IEEE80211 
      select FW_LOADER 
      bool "Broadcom BCM4319 SDIO (Factory Test Only)" 
      ---help--- 
        A library for Broadcom BCM4319 SDIO WLAN devices. 
                
	config RALINK_RT3070
	  depends on WLAN_80211 && USB
	  select WIRELESS_EXT
	  select IEEE80211
	  select FW_LOADER
	  bool "Ralink RT3070 USB"
	  ---help---
	    A library for Ralink RT3070 USB WIFI devices.
source "drivers/net/wireless/rtl8192c.rk28/Kconfig"
source "drivers/net/wireless/rtl8188eu/Kconfig"
	#source "drivers/net/wireless/bcm43X9/Kconfig"

endchoice

endmenu
```

## kernel/drivers/video/display/screen/Kconfig
```kconfig
choice
    depends on DISPLAY_SUPPORT
	prompt  "LCD Panel Select"
config LCD_NULL
	bool "NULL"
config LCD_TD043MGEA1
	bool "RGB TD043MGEA1"
config LCD_AT070TN93
    bool "RGB AT070TN93"
config LCD_TJ048NC01CA
    bool "RGB TJ048NC01CA"
config LCD_HL070VM4AU
    bool "RGB_HL070VM4AU"
config LCD_HSD070IDW1
    bool "RGB Hannstar800x480"
config LCD_A060SE02
    bool "MCU A060SE02"
config LCD_S1D13521
    bool "MCU S1D13521"
config LCD_NT35582
	bool "MCU NT35582"
config LCD_NT35580
	bool "MCU NT35580"
config LCD_RK_EINK
	bool "RK EINK"
endchoice

choice
	prompt "Epd RotMode Select"
	depends on LCD_S1D13521 || LCD_RK_EINK
config EPD_ROTMODE_0
	bool "RotMode 0"    
config EPD_ROTMODE_90
	bool "RotMode 90"
config EPD_ROTMODE_180
	bool "RotMode 180"    
config EPD_ROTMODE_270
	bool "RotMode 270"
endchoice

choice
    depends on DISPLAY_SUPPORT
	prompt  "TVOUT Chip Select"
config TV_NULL
	bool "NULL"
config TV_RK1000
	bool "TV_RK1000"
endchoice

choice
    depends on DISPLAY_SUPPORT
	prompt  "HDMI Chip Select"
config HDMI_NULL
	bool "NULL"
config HDMI_ANX7150
	bool "HDMI ANX7150"
endchoice

choice
	depends on DISPLAY_SUPPORT
	prompt	"LCD resolution"
config HIGH_LCD_RESOLUTION_NULL
	bool "NULL"
config HIGH_LCD_RESOLUTION
	bool "LCD resolution >=800*600"
endchoice
source "drivers/video/display/screen/epd/Kconfig"
```

## kernel/drivers/video/display/screen/epd/Kconfig
```kconfig
choice
	prompt "Epd Panel Select"
	depends on LCD_RK_EINK
config V110_EINK_800X600
	bool "v110 eink_800X600"
config V110_EINK_1024X768
	bool "v110 eink_1024X768"
config V220_EINK_800X600
	bool "v220 eink_800X600"
config V220_EINK_480X800
	bool "v220 eink_480X800"
config V220_EINK_1024X768
	bool "v220 eink_1024X768"
config V110_EINK_1024X600
	bool "v110 eink_1024X600"
config V110_1200x825_EINK
	bool "v110 eink_1200x825"
endchoice

config EINK_SCREEN_X
	int "Horizontal eink screen resolution"
	depends on LCD_RK_EINK
	default "600"
	help
	  resolution, rk eink screen width

config EINK_SCREEN_Y
	int "Vertical eink screen resolution"
	depends on LCD_RK_EINK
	default "800"
	help
	  resolution, rk eink screen height

config TCON_DSP
	bool "Enable DSP to decode e-ink data"
	depends on LCD_RK_EINK
	default y
	---help---
	dsp decode e-ink data have better effect

choice 
	prompt "Eink voltage select"
config EPD_VOLTAGE_CTL
       bool "epd voltage"
       depends on LCD_RK_EINK
config EPD_TI_65185
			  bool "Ti tps65185"
       depends on LCD_RK_EINK
endchoice

choice 
	prompt "Eink temperature sensor"
config EPD_LM75
       bool "LM75"
       depends on EPD_VOLTAGE_CTL
config EPD_SN1086
       bool "SN1086"
       depends on EPD_VOLTAGE_CTL
config EPD_NTC
       bool "NTC"
       depends on EPD_VOLTAGE_CTL
endchoice     


	
choice
	prompt "waveform data source"
	depends on LCD_RK_EINK

config WAVEFORM_FROM_NAND
	bool "from nand flash"
endchoice





config WAVEFORM_NAND_ADDR
	hex "waveform nand flash address"
	depends on WAVEFORM_FROM_NAND
	default "0x67800000"


config SPI_FLASH_SPEED_MHZ
	int "SPI flash speed MHz"
	depends on WAVEFORM_FROM_EEPROM
	default "20"
	
config EPD_IDLE_TIME
	int "epd idle time"
	depends on LCD_RK_EINK
	default "60"
---help---
	time = value*50ms
```

## kernel/sound/soc/rockchip/Kconfig
```kconfig
config SND_ROCKCHIP_SOC
	tristate "SoC Audio for the rockchip RK28 System-on-Chip"
	depends on ARCH_ROCKCHIP && SND_SOC
	help
	  Say Y or M if you want to add support for codecs attached to
	  the ROCKCHIP IIS interface. You will also need
	  to select the audio interfaces to support below.

config SND_ROCKCHIP_SOC_IIS
	tristate 

config SND_ROCKCHIP_SOC_WM8988
	tristate "SoC I2S Audio support for rockchip - WM8988"
	depends on SND_ROCKCHIP_SOC 
	select SND_ROCKCHIP_SOC_IIS
	select SND_SOC_WM8988
	help
	  Say Y if you want to add support for SoC audio on rockchip
	  with the WM8988.
config SND_ROCKCHIP_SOC_WM8994
	tristate "SoC I2S Audio support for rockchip - WM8994"
	depends on SND_ROCKCHIP_SOC 
	select SND_ROCKCHIP_SOC_IIS
	select SND_SOC_WM8994
	help
	  Say Y if you want to add support for SoC audio on rockchip
	  with the WM8994.
	  
config SND_ROCKCHIP_SOC_RK1000
	tristate "SoC I2S Audio support for rockchip - RK1000"
	depends on SND_ROCKCHIP_SOC 
	select SND_ROCKCHIP_SOC_IIS
	select SND_SOC_RK1000
	help
	  Say Y if you want to add support for SoC audio on rockchip
	  with the RK1000.	 

config SND_ROCKCHIP_SOC_WM8904
	tristate "SoC I2S Audio support for rockchip - WM8904"
	depends on SND_ROCKCHIP_SOC 
	select SND_ROCKCHIP_SOC_IIS
	select SND_SOC_WM8904
	help
	  Say Y if you want to add support for SoC audio on rockchip
	  with the WM8904.

config SND_ROCKCHIP_SOC_ES8388
	tristate "SoC I2S Audio support for rockchip - ES8388"
	depends on SND_ROCKCHIP_SOC 
	select SND_ROCKCHIP_SOC_IIS
	select SND_SOC_ES8388
	help
	  Say Y if you want to add support for SoC audio on rockchip
	  with the ES8388. 

if SND_ROCKCHIP_SOC_WM8988 || SND_ROCKCHIP_SOC_RK1000	|| SND_ROCKCHIP_SOC_WM8994 || SND_ROCKCHIP_SOC_WM8904 || SND_ROCKCHIP_SOC_ES8388
choice
  prompt "set i2s type"
	config SND_ROCKCHIP_SOC_SLAVE
		tristate "Run codec in slave Mode on Endrelia boards"

	config  SND_ROCKCHIP_SOC_MASTER
		tristate  "Run codec in master Mode on Endrelia boards"
endchoice
endif
```
